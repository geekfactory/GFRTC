/**
   GeekFactory - "INNOVATING TOGETHER"
   Distribucion de materiales para el desarrollo e innovacion tecnologica
   www.geekfactory.mx

   This example shows how to configure the alarms on the DS3231 and DS3232.

   The RTC is configured to generate an alarm signal each minute when the seconds
   register matches with the value configured on the alarm register.
*/
#include <GFRTC.h>

// Flag used to indicate that DS3231 generated an interrupt
volatile bool rtcflag = false;

void setup() {
  // prepare serial interface
  Serial.begin(115200);
  while (!Serial);

  // show message on serial monitor
  Serial.println(F("----------------------------------------------------"));
  Serial.println(F("             GFRTC LIBRARY TEST PROGRAM             "));
  Serial.println(F("             https://www.geekfactory.mx             "));
  Serial.println(F("----------------------------------------------------"));

  // prepare the GFRTC class, this also calls Wire.begin()
  GFRTC.begin(true);

  // check if we can communicate with RTC
  if (GFRTC.isPresent()) {
    Serial.println(F("RTC connected and ready."));
  } else {
    Serial.println(F("Check RTC connections and try again."));
    for (;;);
  }

  // enable interrupt output on INT/SQW pin from DS3231
  GFRTC.setIntSqwMode(E_INTERRUPT_OUTPUT);

  // configure the alarm
  GFRTC.setAlarm(E_ALM1_MATCH_SECONDS, 0, 0, 10, 1);

  // enable the interrupts for alarm 1
  GFRTC.setAlarmInterrupt(E_ALARM_1, true);

  // clear the interrupt flag by reading it
  GFRTC.getAlarmInterruptFlag(E_ALARM_1);

  // attach interrupt, this calls isrhandler function on every falling edge
  pinMode(2, INPUT);
  attachInterrupt(digitalPinToInterrupt(2), isrhandler, FALLING);
}

void loop()
{
  // check if we received interrupt signal
  if (rtcflag) {
    // clear flag and display time
    rtcflag = false;

    // check if interrupt is generated by alarm 1
    if (GFRTC.getAlarmInterruptFlag(E_ALARM_1)) {
      Serial.print(F("ALARM1 "));
    }

    // check if interrupt is generated by alarm 2
    if (GFRTC.getAlarmInterruptFlag(E_ALARM_2)) {
      Serial.print(F("ALARM2: "));
    }

    // display time
    readAndDisplayTime();
  }
}

/**
   Sets a flag when interrupt signal is received from DS3231
*/
void isrhandler()
{
  rtcflag = true;
}

/**
   Prints date and time to serial monitor
*/
void readAndDisplayTime() {
  // structure to hold data from RTC
  struct timelib_tm datetime;

  Serial.print(F("Got interrupt signal, time is = "));

  // get date and time
  if (GFRTC.read(datetime)) {
    // read ok, print data from RTC
    print2digits(datetime.tm_hour);
    Serial.write(':');
    print2digits(datetime.tm_min);
    Serial.write(':');
    print2digits(datetime.tm_sec);
    Serial.print(F(", Date (D/M/Y) = "));
    Serial.print(datetime.tm_mday);
    Serial.write('/');
    Serial.print(datetime.tm_mon);
    Serial.write('/');
    Serial.print(timelib_tm2y2k(datetime.tm_year));
    Serial.println();
  } else {
    // error reading the RTC
    Serial.println(F("Cannot read RTC."));
  }
}

/**
   Helper function to print always two digits
*/
void print2digits(int number) {
  if (number >= 0 && number < 10) {
    Serial.write('0');
  }
  Serial.print(number);
}
